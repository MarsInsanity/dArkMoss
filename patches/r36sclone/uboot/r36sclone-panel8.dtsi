// SPDX-License-Identifier:     GPL-2.0+
/*
 * G80CA "Panel 8" (ST7703), a node of r36sclone-uboot.dts's &dsi: the panel
 * included first is the one U-Boot starts with. The ID is the one the
 * G350's ST7703 answers to DCS 0x04, not yet read on a G80CA.
 */
panel@8 {
	compatible = "elida,kd35t133", "simple-panel-dsi";
	reg = <0>;
	id-reg = <0x04>;
	id = [38 21];

	/* pwm1 backlight */
	backlight = <&backlight>;
	/* RK817 LDO7 */
	backlight-supply = <&vcc_backlight>;
	power-supply = <&vcc18_lcd0>;

	/* LCD reset GPIO3.D3, LCD power GPIO3.A3 */
	reset-gpios = <&gpio3 RK_PD3 GPIO_ACTIVE_LOW>;
	enable-gpios = <&gpio3 RK_PA3 GPIO_ACTIVE_HIGH>;

	prepare-delay-ms = <20>;
	reset-delay-ms = <20>;
	init-delay-ms = <20>;
	enable-delay-ms = <120>;
	disable-delay-ms = <20>;
	unprepare-delay-ms = <20>;

	/* LCD size */
	width-mm = <153>;
	height-mm = <85>;

	dsi,flags = <(MIPI_DSI_MODE_VIDEO           |
		      MIPI_DSI_MODE_VIDEO_BURST     |
		      MIPI_DSI_MODE_LPM             |
		      MIPI_DSI_MODE_EOT_PACKET)>;

	dsi,format = <MIPI_DSI_FMT_RGB888>;
	dsi,lanes = <4>;

	panel-init-sequence = [
		39 00 04 B9 F1 12 83
		39 00 06 B1 00 00 00 DA 80
		39 00 04 B2 00 13 70
		39 00 0B B3 10 10 28 28 03 FF 00 00 00 00
		15 00 02 B4 80
		15 00 03 B5 0A 0A
		15 00 03 B6 82 82
		39 00 05 B8 26 62 F0 63
		39 00 1C BA 33 81 05 F9 0E 0E 20 00 00 00 00 00 00 00 44 25 00 90 0A 00 00 01 4F 01 00 00 37
		15 00 02 BC 47
		39 00 04 BF 02 11 00
		39 00 0A C0 73 73 50 50 00 00 12 50 00
		39 00 0D C1 53 00 32 32 77 D1 CC CC 77 77 33 33
		39 00 07 C6 82 00 BF FF 00 FF
		39 00 07 C7 B8 00 0A 00 00 00
		39 00 05 C8 10 40 1E 02
		15 00 02 CC 0B
		39 00 23 E0 00 07 0D 37 35 3F 41 44 06 0C 0D 0F 11 10 12 14 1A 00 07 0D 37 35 3F 41 44 06 0C 0D 0F 11 10 12 14 1A
		39 00 0F E3 07 07 0B 0B 0B 0B 00 00 00 00 FF 00 C0 10
		39 00 40 E9 C8 10 02 00 00 B0 B1 11 31 23 28 80 B0 B1 27 08 00 04 02 00 00 00 00 04 02 00 00 00 88 88 BA 60 24 08 88 88 88 88 88 88 88 BA 71 35 18 88 88 88 88 88 00 00 00 01 00 00 00 00 00 00 00 00 00
		39 00 3E EA 97 0A 82 02 03 07 00 00 00 00 00 00 81 88 BA 17 53 88 88 88 88 88 88 80 88 BA 06 42 88 88 88 88 88 88 23 00 00 02 80 00 00 00 00 00 00 00 00 00 00 00 00 00 00 00 00 00 00 00 00 00 00
		39 00 04 EF FF FF 01
		05 C8 01 11
		05 14 01 29
	];

	/* 28: DisplayOff */
	/* 10: SleepIn */
	panel-exit-sequence = [
		05 00 01 28
		05 00 01 10
	];

	display-timings {
		native-mode = <&timing8>;

		/* 60.02 Hz, the kernel's native-mode */
		timing8: 60Hz {
			clock-frequency = <30000000>;
			hactive = <640>;
			vactive = <480>;
			hfront-porch = <150>;
			hsync-len = <40>;
			hback-porch = <135>;
			vfront-porch = <20>;
			vsync-len = <6>;
			vback-porch = <12>;
			hsync-active = <0>;
			vsync-active = <0>;
			de-active = <0>;
			pixelclk-active = <0>;
		};
	};
};
